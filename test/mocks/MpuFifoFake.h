#pragma once
#include <Wire.h>
#include <deque>
#include <array>

// FIFO contents are generated by tests independently of host polling. This permits
// loss/phase tests that cannot pass by inventing a new sample on each read.
struct MpuFifoFake {
  std::deque<uint8_t> fifo;
  uint8_t interrupt = 0;
  unsigned packets_read = 0, resets = 0;
  int short_bytes = -1;
  bool overflow_after_read = false;
  MpuFifoFake() {
    Wire1 = TwoWire{};
    Wire1.write_observer = [this](uint8_t reg, uint8_t value) {
      if (reg == 0x6A && (value & 0x04)) {
        fifo.clear(); interrupt = 0; ++resets;
        Wire1.registers[reg] &= ~0x04;
      }
    };
    Wire1.response = [this](uint8_t reg, uint8_t count) {
      if (reg == 0x75) return std::vector<uint8_t>{0x68};
      if (reg == 0x3A) {
        const uint8_t value = interrupt; interrupt = 0;
        return std::vector<uint8_t>{value};
      }
      if (reg == 0x72) return std::vector<uint8_t>{uint8_t(fifo.size() >> 8), uint8_t(fifo.size())};
      if (reg == 0x74) {
        std::vector<uint8_t> out;
        const unsigned size = short_bytes < 0 ? count : unsigned(short_bytes);
        for (unsigned i = 0; i < size && !fifo.empty(); ++i) {
          out.push_back(fifo.front()); fifo.pop_front();
        }
        packets_read += out.size() / 14;
        if (overflow_after_read) interrupt |= 0x10;
        return out;
      }
      return count == 1 ? std::vector<uint8_t>{Wire1.registers[reg]} : std::vector<uint8_t>{};
    };
  }
  ~MpuFifoFake() { Wire1 = TwoWire{}; }
  void push(float acceleration = 1, float rotation = 0) {
    pushRaw({{0, 0, int16_t(acceleration * 4096), 0, int16_t(rotation * 65.5f), 0, 0}});
  }
  void pushRaw(const std::array<int16_t, 7>& words) {
    for (int16_t value : words) { fifo.push_back(uint16_t(value) >> 8); fifo.push_back(uint8_t(value)); }
    interrupt |= fifo.size() >= 1024 ? 0x11 : 0x01;
  }
};
